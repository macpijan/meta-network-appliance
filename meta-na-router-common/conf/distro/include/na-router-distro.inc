## meta-na-router-common/conf/distro/include/na-router-distro.inc
```bitbake
require conf/distro/poky.conf

DISTRO = "na-router-distro"

# distro name
DISTRO_NAME = "Network Appliance - Router Distro"
DISTRO_VERSION = "0.1.0"
SDK_VENDOR = "-narsdk"

MAINTAINER = "Maciej Pijanowski <maciej.pijanowski@3mdeb.com>"

TARGET_VENDOR = "-nar"

# distro features
DISTRO_FEATURES = "${DISTRO_FEATURES_DEFAULT} systemd pam"
DISTRO_FEATURES_remove = " alsa bluetooth pcmcia zeroconf x11 wayland nfc"

# explictely use systemd and disable sysvinit completely
VIRTUAL-RUNTIME_init_manager = "systemd"
VIRTUAL-RUNTIME_initscripts = ""
VIRTUAL-RUNTIME_syslog = ""
DISTRO_FEATURES_BACKFILL_CONSIDERED += "sysvinit pulseaudio"

WKS_FILES = "otab-grub-x86-legacy.wks.in"
```

## meta-na-router-common/conf/distro/na-router-docker.conf
```bitbake
require conf/distro/include/na-router-distro.inc

DISTRO_FEATURES_append = " virtualization"
```

## meta-na-router-common/conf/layer.conf
```bitbake
# We have a conf and classes directory, add to BBPATH
BBPATH .= ":${LAYERDIR}"

# We have recipes-* directories, add to BBFILES
BBFILES += "${LAYERDIR}/recipes-*/*/*.bb ${LAYERDIR}/recipes-*/*/*.bbappend"

BBFILE_COLLECTIONS += "na-router-common"
BBFILE_PATTERN_na-router-common = "^${LAYERDIR}/"
BBFILE_PRIORITY_na-router-common = "10"

# This should only be incremented on significant changes that will
# cause compatibility issues with other layers
LAYERVERSION_na-router-common = "1"

LAYERDEPENDS_na-router-common = " \
    core \
    openembedded-layer \
    "

LAYERSERIES_COMPAT_na-router-common = "kirkstone"
```

## meta-na-webui/conf/layer.conf
```bitbake
# We have a conf and classes directory, add to BBPATH
BBPATH .= ":${LAYERDIR}"

# We have recipes-* directories, add to BBFILES
BBFILES += "${LAYERDIR}/recipes-*/*/*.bb ${LAYERDIR}/recipes-*/*/*.bbappend"

BBFILE_COLLECTIONS += "na-webui"
BBFILE_PATTERN_na-webui = "^${LAYERDIR}/"
BBFILE_PRIORITY_na-webui = "10"

# This should only be incremented on significant changes that will
# cause compatibility issues with other layers
LAYERVERSION_na-webui = "1"

LAYERDEPENDS_na-webui = " \
    core \
    openembedded-layer \
    "

LAYERSERIES_COMPAT_na-webui = "kirkstone"
```

## meta-router-common/conf/layer.conf
```bitbake
# We have a conf and classes directory, add to BBPATH
BBPATH .= ":${LAYERDIR}"

# We have recipes-* directories, add to BBFILES
BBFILES += "${LAYERDIR}/recipes-*/*/*.bb ${LAYERDIR}/recipes-*/*/*.bbappend"

BBFILE_COLLECTIONS += "router-common"
BBFILE_PATTERN_router-common = "^${LAYERDIR}/"
BBFILE_PRIORITY_router-common = "10"

# This should only be incremented on significant changes that will
# cause compatibility issues with other layers
LAYERVERSION_router-common = "1"

LAYERDEPENDS_router-common = " \
    core \
    openembedded-layer \
    "

LAYERSERIES_COMPAT_router-common = "dunfell master"
```
